## programs/oot_mp3_demo/oot_module/drivers/sensor/mp3yx5300/Kconfig
```kconfig
# EMINV energy meter interface Sensor configuration options
# Copyright (c) 2024 ubaid
# SPDX-License-Identifier: Apache-2.0

menuconfig MP3_YX5300
	bool "serial mp3 player yx5300"
	depends on UART_INTERRUPT_DRIVEN
	help
	  Enable driver for the serial mp3 player yx5300
```

## programs/oot_mp3_demo/oot_module/dts/bindings/sensor/zephyr,mp3yx5300.yaml
```yaml
# Copyright (c) 2024 unknow
# SPDX-License-Identifier: Apache-2.0

description: serial mp3 player yx5300

compatible: "zephyr,mp3yx5300"

include: uart-device.yaml
```
